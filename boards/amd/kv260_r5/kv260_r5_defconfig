## boards/amd/kv260_r5/kv260_r5_defconfig
```kconfig
CONFIG_XIP=n

CONFIG_ISR_STACK_SIZE=512
CONFIG_MAIN_STACK_SIZE=2048
CONFIG_THREAD_STACK_INFO=y

# Enable console
CONFIG_CONSOLE=y
CONFIG_UART_CONSOLE=y
# CONFIG_STDOUT_CONSOLE=y
# CONFIG_CONSOLE_SUBSYS=y
# CONFIG_CONSOLE_GETLINE=y
# CONFIG_CONSOLE_GETCHAR=y
# CONFIG_CONSOLE_HANDLER=y
# CONFIG_TICKLESS_KERNEL=y
# CONFIG_SHELL=y
# CONFIG_SHELL_BACKEND_SERIAL=y
# CONFIG_CONSOLE_GETCHAR_BUFSIZE=64
# CONFIG_CONSOLE_PUTCHAR_BUFSIZE=512

# Enable serial port 
CONFIG_SERIAL=y
CONFIG_UART_XLNX_PS=n
CONFIG_UART_INTERRUPT_DRIVEN=y
CONFIG_UART_NS16550=y
# CONFIG_UART_LINE_CTRL=y
# CONFIG_UART_NS16550_LINE_CTRL=y

# System Timer
CONFIG_XLNX_PSTTC_TIMER_INDEX=0
CONFIG_SYS_CLOCK_TICKS_PER_SEC=10000
CONFIG_SYS_CLOCK_HW_CYCLES_PER_SEC=100000000

# Memory Protection Unit (todo: turn it on)
CONFIG_ARM_MPU=n

# Network driver config
# CONFIG_NETWORKING=y
# CONFIG_TEST_RANDOM_GENERATOR=y
# CONFIG_ETH_XILINX_AXIENET=y
# CONFIG_DMA_XILINX_AXI_DMA=y
# CONFIG_DMA=y
# CONFIG_ETH_DRIVER=y
# CONFIG_MDIO_XILINX_AXI_ENET=y
# CONFIG_MDIO=y
```

## boards/amd/vck190_r5/Kconfig.defconfig
```kconfig
# Copyright (c) 2022 Linaro.
# SPDX-License-Identifier: Apache-2.0

if BOARD_VCK190_R5

config BUILD_OUTPUT_BIN
	default y

if USERSPACE

config COMPILER_ISA_THUMB2
	default n

endif

endif # BOARD_VCK190_R5
```

## boards/amd/vck190_r5/Kconfig.vck190_r5
```kconfig
# Copyright (c) 2022 Linaro.
# SPDX-License-Identifier: Apache-2.0

config BOARD_VCK190_R5
	select SOC_XILINX_ZYNQMP_RPU
```

## boards/amd/vck190_r5/vck190_r5_defconfig
```kconfig
# This is for booting from flash memory
CONFIG_XIP=n

### Enable console
CONFIG_SERIAL=y
CONFIG_CONSOLE=y
CONFIG_CONSOLE_HANDLER=y
CONFIG_UART_CONSOLE=y
CONFIG_UART_INTERRUPT_DRIVEN=y
CONFIG_UART_NS16550=y
CONFIG_SHELL_BACKEND_SERIAL_TX_RING_BUFFER_SIZE=8
CONFIG_SHELL_BACKEND_SERIAL_RX_RING_BUFFER_SIZE=512
CONFIG_SHELL_PROMPT_UART="te0950-r5:~$ "
CONFIG_UART_XLNX_PS=n

### System Timer (ttc0 @ 100MHz)
CONFIG_XLNX_PSTTC_TIMER_INDEX=0
CONFIG_SYS_CLOCK_TICKS_PER_SEC=10000
CONFIG_SYS_CLOCK_HW_CYCLES_PER_SEC=100000000

### Disable Memory Protection Unit
CONFIG_ARM_MPU=n

### General Config
CONFIG_REQUIRES_FULL_LIBC=y

### Logging
CONFIG_LOG=y
CONFIG_LOG_PRINTK=y
CONFIG_LOG_BUFFER_SIZE=4096

#### AXI DMA Config
CONFIG_DMA=y
CONFIG_DMA_XILINX_AXI_DMA_DISABLE_CACHE_WHEN_ACCESSING_SG_DESCRIPTORS=n
CONFIG_DMA_XILINX_AXI_DMA_SG_DESCRIPTOR_NUM_TX=512
CONFIG_DMA_XILINX_AXI_DMA_SG_DESCRIPTOR_NUM_RX=512
CONFIG_DMA_LOG_LEVEL_INF=y
CONFIG_DMA_XILINX_AXI_DMA=y
CONFIG_DMA_LOG_LEVEL_DBG=y

### AXI ETH Config
CONFIG_ETH_DRIVER=y
CONFIG_NET_L2_ETHERNET=y
CONFIG_ETH_XILINX_AXIENET=y
CONFIG_MDIO=y
CONFIG_PHY_GENERIC_MII=y
CONFIG_MDIO_XILINX_AXI_ENET=y
CONFIG_ETHERNET_LOG_LEVEL_DBG=y

### Networking Config
CONFIG_NET_SHELL=y
CONFIG_NETWORKING=y
CONFIG_NET_IPV4=y
CONFIG_NET_IPV6=n
CONFIG_NET_TCP=y
CONFIG_NET_SOCKETS=y
CONFIG_NET_SOCKETS_PACKET=y
CONFIG_NET_SOCKETS_PACKET_DGRAM=y
CONFIG_POSIX_API=y
CONFIG_NET_STATISTICS=y
CONFIG_NET_ICMPV4_ACCEPT_BROADCAST=y
CONFIG_NET_IPV4_ACCEPT_ZERO_BROADCAST=y
CONFIG_NET_STATISTICS_ETHERNET=y
CONFIG_NET_DRIVERS=y
CONFIG_NET_LOOPBACK=y
CONFIG_ENTROPY_GENERATOR=y
CONFIG_TIMER_RANDOM_GENERATOR=y
CONFIG_TEST_RANDOM_GENERATOR=y

### Network address Config
CONFIG_NET_CONFIG_SETTINGS=y
CONFIG_NET_CONFIG_NEED_IPV4=y
CONFIG_NET_CONFIG_MY_IPV4_ADDR="192.0.2.3"
CONFIG_NET_CONFIG_MY_IPV4_NETMASK="255.255.255.0"
CONFIG_NET_CONFIG_PEER_IPV4_ADDR="192.0.2.2"
CONFIG_NET_TCP_TIME_WAIT_DELAY=0
CONFIG_NET_IP_ADDR_CHECK=y

### Network Packet Management
CONFIG_NET_PKT_RX_COUNT=1024
CONFIG_NET_PKT_TX_COUNT=1024
CONFIG_NET_BUF_RX_COUNT=1024
CONFIG_NET_BUF_TX_COUNT=1024
CONFIG_NET_BUF_DATA_SIZE=1744
CONFIG_NET_TC_SKIP_FOR_HIGH_PRIO=y
CONFIG_NET_TC_RX_COUNT=0
CONFIG_NET_TC_TX_COUNT=0

### Network Debug Config
# CONFIG_NET_LOG=y
# CONFIG_NET_IF_LOG_LEVEL_DBG=y
# CONFIG_NET_CORE_LOG_LEVEL_DBG=y
# CONFIG_NET_ICMPV4_LOG_LEVEL_DBG=y
# CONFIG_NET_DEBUG_NET_PKT_ALLOC=y
# CONFIG_NET_PKT_LOG_LEVEL_DBG=y
# CONFIG_NET_TC_LOG_LEVEL_DBG=y
# CONFIG_NET_CONN_LOG_LEVEL_DBG=y
# CONFIG_NET_SOCKETS_LOG_LEVEL_DBG=y
# CONFIG_NET_CONTEXT_LOG_LEVEL_DBG=y
# CONFIG_NET_TCP_LOG_LEVEL_DBG=y
# CONFIG_NET_UDP_LOG_LEVEL_DBG=y
# CONFIG_NET_IPV4_LOG_LEVEL_DBG=y

### Memory Management Config
CONFIG_HEAP_MEM_POOL_SIZE=16777216
CONFIG_ISR_STACK_SIZE=524288
CONFIG_MAIN_STACK_SIZE=524288
CONFIG_SYSTEM_WORKQUEUE_STACK_SIZE=524288
CONFIG_IDLE_STACK_SIZE=524288
CONFIG_NET_TCP_WORKQ_STACK_SIZE=524288
CONFIG_NET_TX_STACK_SIZE=524288
CONFIG_NET_RX_STACK_SIZE=524288
CONFIG_NET_MGMT_EVENT_STACK_SIZE=524288
CONFIG_NET_MGMT_EVENT_SYSTEM_WORKQUEUE=y
CONFIG_NET_MGMT_EVENT_THREAD=y
CONFIG_POSIX_THREAD_THREADS_MAX=10
CONFIG_STACK_SENTINEL=y

# CONFIG_NET_TC_THREAD_PRIO_CUSTOM=y
# CONFIG_NET_TC_THREAD_PREEMPTIVE=y
# CONFIG_NET_TCP_WORKER_PRIO=-16
# CONFIG_NET_TC_TX_THREAD_BASE_PRIO=3
# CONFIG_NET_TC_RX_THREAD_BASE_PRIO=3
# CONFIG_ZPERF_WORK_Q_THREAD_PRIORITY=3
# CONFIG_NET_SOCKETS_SERVICE_THREAD_PRIO=3
# CONFIG_NET_TC_SKIP_FOR_HIGH_PRIO=y
# CONFIG_NET_CONTEXT_PRIORITY=y
# CONFIG_NET_SOCKETS_SERVICE=y
```

## boards/trenz/te0950_mbv32/Kconfig.defconfig
```kconfig
#
# Copyright (c) 2024 Owusu Consulting
#
# SPDX-License-Identifier: Apache-2.0
#

if BOARD_TE0950_MBV32

DT_CHOSEN_Z_BRAM := zephyr,bram

config SHARED_BRAM_BASE_OFFSET
    hex
	default $(dt_chosen_reg_addr_hex,$(DT_CHOSEN_Z_BRAM))

endif # BOARD_TE0950_MBV32
```

## boards/trenz/te0950_mbv32/te0950_mbv32_defconfig
```kconfig
#
# Copyright (c) 2024 Owusu Consulting
#
# SPDX-License-Identifier: Apache-2.0
#
CONFIG_LOG=y
CONFIG_LOG_MODE_IMMEDIATE=y

CONFIG_XIP=n
CONFIG_SYS_CLOCK_HW_CYCLES_PER_SEC=100000000
CONFIG_HEAP_MEM_POOL_SIZE=4096
CONFIG_GPIO=y

####### Watchdog Settings #########
CONFIG_WATCHDOG=y
CONFIG_WDT_XILINX_AXI=y
CONFIG_TASK_WDT=y
CONFIG_WDT_XILINX_AXI_HWINFO_API=y
CONFIG_WDT_LOG_LEVEL_DBG=y
CONFIG_TASK_WDT_MIN_TIMEOUT=2000
CONFIG_THREAD_NAME=y
```

## boards/trenz/te0950_r5/Kconfig.te0950_r5
```kconfig
# Copyright (c) 2022 Linaro.
# SPDX-License-Identifier: Apache-2.0

config BOARD_TE0950_R5
	select SOC_XILINX_VERSAL_RPU
```

## boards/trenz/te0950_r5/te0950_r5_defconfig
```kconfig
# This is for booting from flash memory
CONFIG_XIP=n
CONFIG_TICKLESS_KERNEL=y
CONFIG_BOOT_BANNER=y
CONFIG_BOOT_BANNER_STRING="Booting Zephyr Kondor-OS build"

### Enable console
CONFIG_SERIAL=y
CONFIG_CONSOLE=y
CONFIG_CONSOLE_HANDLER=y
CONFIG_UART_CONSOLE=y
CONFIG_UART_INTERRUPT_DRIVEN=y
CONFIG_UART_NS16550=y
CONFIG_LOG_BACKEND_UART=y
CONFIG_UART_XLNX_PS=n
CONFIG_SHELL_PROMPT_UART="te0950-r5:~$ "
CONFIG_SHELL_BACKEND_SERIAL_TX_RING_BUFFER_SIZE=8
CONFIG_SHELL_BACKEND_SERIAL_RX_RING_BUFFER_SIZE=512
CONFIG_SHELL_BACKEND_SERIAL_FORCE_TX_BLOCKING_MODE=y

### System Timer (ttc0 @ 100MHz)
CONFIG_XLNX_PSTTC_TIMER_INDEX=0
CONFIG_SYS_CLOCK_TICKS_PER_SEC=10000
CONFIG_SYS_CLOCK_HW_CYCLES_PER_SEC=100000000
CONFIG_THREAD_RUNTIME_STATS=y

### Disable Memory Protection Unit
CONFIG_ARM_MPU=n

### Logging
CONFIG_LOG=y
CONFIG_LOG_PRINTK=y
CONFIG_LOG_BUFFER_SIZE=4096

#### AXI DMA Config
CONFIG_DMA=y
# CONFIG_DMA_64BIT=y

# Do not enable, mainline implementation not performant/incorrect
CONFIG_DMA_XILINX_AXI_DMA_DISABLE_CACHE_WHEN_ACCESSING_SG_DESCRIPTORS=n

CONFIG_DMA_XILINX_AXI_DMA_SG_DESCRIPTOR_NUM_TX=512
CONFIG_DMA_XILINX_AXI_DMA_SG_DESCRIPTOR_NUM_RX=512
CONFIG_DMA_LOG_LEVEL_INF=y
CONFIG_DMA_XILINX_AXI_DMA=y
CONFIG_DMA_XILINX_AXI_DMA_LOCK_DMA_IRQS=y
CONFIG_DMA_XILINX_AXI_DMA_POLL_INTERVAL=500
CONFIG_DMA_XILINX_AXI_DMA_INTERRUPT_THRESHOLD=1
CONFIG_DMA_XILINX_AXI_DMA_INTERRUPT_TIMEOUT=0
# CONFIG_DMA_LOG_LEVEL_DBG=y
CONFIG_DMA_64BIT=n

### AXI ETH Config
CONFIG_ETH_DRIVER=y
CONFIG_NET_L2_ETHERNET=y
CONFIG_ETH_XILINX_AXIENET=y
CONFIG_MDIO=y
CONFIG_PHY_GENERIC_MII=y
CONFIG_MDIO_XILINX_AXI_ENET=y
# CONFIG_ETHERNET_LOG_LEVEL_DBG=y

### Networking Config
CONFIG_NET_SHELL=y
CONFIG_NETWORKING=y
CONFIG_NET_IPV4=y
CONFIG_NET_IPV6=n
CONFIG_NET_TCP=y
CONFIG_NET_UDP=y
CONFIG_NET_SOCKETS=y
CONFIG_NET_SOCKETS_PACKET=y
CONFIG_NET_SOCKETS_PACKET_DGRAM=y
CONFIG_POSIX_API=y
CONFIG_NET_STATISTICS=y
CONFIG_NET_ICMPV4_ACCEPT_BROADCAST=y
CONFIG_NET_IPV4_ACCEPT_ZERO_BROADCAST=n
CONFIG_NET_LOG=y
CONFIG_NET_STATISTICS_ETHERNET=n
CONFIG_NET_DRIVERS=y
CONFIG_NET_TCP_TIME_WAIT_DELAY=0
CONFIG_NET_IP_ADDR_CHECK=n
CONFIG_NET_LOOPBACK=y

### Network driver Config
CONFIG_ENTROPY_GENERATOR=y
CONFIG_TIMER_RANDOM_GENERATOR=y
CONFIG_TEST_RANDOM_GENERATOR=y

### Network address Config
CONFIG_NET_CONFIG_SETTINGS=y
CONFIG_NET_CONFIG_NEED_IPV4=y
CONFIG_NET_CONFIG_MY_IPV4_ADDR="192.0.2.3"
CONFIG_NET_CONFIG_MY_IPV4_NETMASK="255.255.255.0"
CONFIG_NET_CONFIG_MY_IPV4_GW="192.0.2.1"
CONFIG_NET_CONFIG_PEER_IPV4_ADDR="192.0.2.2"
# CONFIG_NET_CONFIG_NEED_IPV6=y
# CONFIG_NET_CONFIG_MY_IPV6_ADDR="2001:db8::3"
# CONFIG_NET_CONFIG_PEER_IPV6_ADDR="2001:db8::2"
# CONFIG_NET_ICMPV4_LOG_LEVEL_DBG=y
# CONFIG_NET_CORE_LOG_LEVEL_DBG=y
# CONFIG_NET_IF_LOG_LEVEL_DBG=y
# CONFIG_NET_CONN_LOG_LEVEL_DBG=y
# CONFIG_NET_TC_LOG_LEVEL_DBG=y
# CONFIG_NET_TCP_LOG_LEVEL_DBG=y
# CONFIG_NET_UDP_LOG_LEVEL_DBG=y
# CONFIG_NET_IPV4_LOG_LEVEL_DBG=y
# CONFIG_NET_ARP_LOG_LEVEL_DBG=y
# CONFIG_NET_CONTEXT_LOG_LEVEL_DBG=y
# CONFIG_NET_MGMT_EVENT_LOG_LEVEL_DBG=y
# CONFIG_NET_SOCKETS_LOG_LEVEL_DBG=y
CONFIG_NET_PKT_LOG_LEVEL_DBG=n
CONFIG_NET_BUF_POOL_USAGE=n

# Network packet management
CONFIG_NET_PKT_RX_COUNT=1024
CONFIG_NET_PKT_TX_COUNT=1024
CONFIG_NET_BUF_RX_COUNT=1024
CONFIG_NET_BUF_TX_COUNT=1024
CONFIG_NET_BUF_DATA_SIZE=1744
CONFIG_NET_TC_RX_COUNT=1
CONFIG_NET_TC_TX_COUNT=1
CONFIG_NET_TX_DEFAULT_PRIORITY=0
CONFIG_NET_RX_DEFAULT_PRIORITY=0
CONFIG_NET_BUF_ALIGNMENT=32

# Debug Config
CONFIG_NET_DEBUG_NET_PKT_ALLOC=n

## Event Monitoring
# CONFIG_NET_MGMT_EVENT=y
# CONFIG_NET_MGMT_EVENT_INFO=y
# CONFIG_NET_MGMT_EVENT_MONITOR=y
# CONFIG_NET_MGMT_EVENT_MONITOR_AUTO_START=y

### Memory Management Config
CONFIG_HEAP_MEM_POOL_SIZE=8388608
CONFIG_ISR_STACK_SIZE=1024
CONFIG_MAIN_STACK_SIZE=4096
CONFIG_SYSTEM_WORKQUEUE_STACK_SIZE=2048
CONFIG_IDLE_STACK_SIZE=1024
CONFIG_NET_TCP_WORKQ_STACK_SIZE=2048
CONFIG_NET_TX_STACK_SIZE=2048
CONFIG_NET_RX_STACK_SIZE=2048
CONFIG_NET_MGMT_EVENT_STACK_SIZE=2048
CONFIG_NET_MGMT_EVENT_SYSTEM_WORKQUEUE=y
CONFIG_NET_MGMT_EVENT_THREAD=y
CONFIG_POSIX_THREAD_THREADS_MAX=10
CONFIG_STACK_SENTINEL=y

### Zperf configs
CONFIG_NET_ZPERF=y
CONFIG_NET_ZPERF_MAX_PACKET_SIZE=1500
CONFIG_ZPERF_WORK_Q_STACK_SIZE=4096
CONFIG_NET_ZPERF_LOG_LEVEL_DBG=n
CONFIG_NET_IF_UNICAST_IPV4_ADDR_COUNT=1
CONFIG_NET_MAX_CONTEXTS=5
CONFIG_NET_MAX_CONN=5
CONFIG_NET_SOCKETS_SERVICE=y
CONFIG_NET_SOCKETS_SERVICE_THREAD_PRIO=-1
CONFIG_NET_SOCKETS_SERVICE_STACK_SIZE=4096
CONFIG_NET_SOCKETS_POLL_MAX=20
CONFIG_ZVFS_OPEN_MAX=32

CONFIG_NET_TC_THREAD_PREEMPTIVE=y
CONFIG_NET_TCP_WORKER_PRIO=-16
CONFIG_ZPERF_WORK_Q_THREAD_PRIORITY=3
CONFIG_NET_CONTEXT_PRIORITY=y
CONFIG_NET_TC_SKIP_FOR_HIGH_PRIO=y

CONFIG_CACHE_MANAGEMENT=y
CONFIG_DCACHE_LINE_SIZE_DETECT=y
CONFIG_ICACHE_LINE_SIZE_DETECT=y
CONFIG_SPEED_OPTIMIZATIONS=y
```

## dts/bindings/mdio/xilinx,axi-ethernet-7.-2-mdio.yaml
```yaml
# Copyright (c) 2024 CISPA Helmholtz Center for Information Security
# SPDX-License-Identifier: Apache-2.0

# Common fields for MDIO controllers

include: mdio-controller.yaml

compatible: xlnx,axi-ethernet-7.2-mdio

description: MDIO interface of Xilinx AXI 1G/2.5G Ethernet Subsystem.
```

## kondor-os/sys_control/sample.yaml
```yaml
sample:
  description: TE0950 Artix System Control
    application
  name: sys_control
common:
  tags: system
  integration_platforms:
    - native_sim
  harness: console
  harness_config:
    type: one_line
    regex:
      - "System (.*)"
```

## soc/xlnx/versal/Kconfig
```kconfig
# Copyright (c) 2024 Northrop Grumman
# SPDX-License-Identifier: Apache-2.0

config SOC_XILINX_VERSAL_RPU
	select ARM
	select CPU_CORTEX_R5
	select PLATFORM_SPECIFIC_INIT
	select CPU_HAS_ARM_MPU
	select VFP_DP_D16
	select CPU_HAS_ICACHE
	select CPU_HAS_DCACHE
```

## soc/xlnx/versal/Kconfig.defconfig
```kconfig
# Copyright (c) 2024 Northrop Grumman
# SPDX-License-Identifier: Apache-2.0

if SOC_XILINX_VERSAL

if SOC_XILINX_VERSAL_RPU

config NUM_IRQS
	# must be >= the highest interrupt number used
	# - include the UART interrupts
	default 220

config SYS_CLOCK_HW_CYCLES_PER_SEC
	default 400000000

endif # SOC_XILINX_VERSAL_RPU

# Workaround for not being able to have commas in macro arguments
DT_CHOSEN_Z_FLASH := zephyr,flash

config FLASH_SIZE
	default $(dt_chosen_reg_size_int,$(DT_CHOSEN_Z_FLASH),0,K)

config FLASH_BASE_ADDRESS
	default $(dt_chosen_reg_addr_hex,$(DT_CHOSEN_Z_FLASH))


endif # SOC_XILINX_VERSAL
```

## soc/xlnx/versal/Kconfig.soc
```kconfig
# Copyright (c) 2024 Northrop Grumman
# SPDX-License-Identifier: Apache-2.0

config SOC_XILINX_VERSAL
	bool

config SOC_XILINX_VERSAL_RPU
	bool
	select SOC_XILINX_VERSAL
	help
	  Xilinx Versal RPU

config SOC_FAMILY
	default "xilinx_versal" if SOC_XILINX_VERSAL

config SOC
	default "versal_rpu" if SOC_XILINX_VERSAL_RPU
```
